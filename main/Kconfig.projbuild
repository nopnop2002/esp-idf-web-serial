## main/Kconfig.projbuild
```kconfig
menu "Application Configuration"

	config GPIO_RANGE_MAX
		int
		default 33 if IDF_TARGET_ESP32
		default 46 if IDF_TARGET_ESP32S2
		default 48 if IDF_TARGET_ESP32S3
		default 18 if IDF_TARGET_ESP32C2
		default 19 if IDF_TARGET_ESP32C3
		default 30 if IDF_TARGET_ESP32C6

	menu "WiFi Setting"

		config ESP_WIFI_SSID
			string "WiFi SSID"
			default "myssid"
			help
				SSID (network name) for the example to connect to.

		config ESP_WIFI_PASSWORD
			string "WiFi Password"
			default "mypassword"
			help
				WiFi password (WPA or WPA2) for the example to use.

		config ESP_MAXIMUM_RETRY
			int "Maximum retry"
			default 5
			help
				Set the Maximum retry to avoid station reconnecting to the AP unlimited when the AP is really inexistent.

		config MDNS_HOSTNAME
			string "mDNS Hostname"
			default "esp32-server"
			help
				The mDNS host name used by the ESP32.

	endmenu

	menu "NTP Setting"

		config NTP_SERVER
			string "NTP Server"
			default "pool.ntp.org"
			help
				Hostname for NTP Server.

		config LOCAL_TIMEZONE
			int "Your TimeZone"
			range -23 23
			default 0
			help
				Your local timezone.	When it is 0, Greenwich Mean Time.

	endmenu


	menu "UART Setting"

		config UART_TX_GPIO
			int "UART TX GPIO number"
			range 0 GPIO_RANGE_MAX
			default 17 if IDF_TARGET_ESP32
			default 35 if IDF_TARGET_ESP32S2 || IDF_TARGET_ESP32S3
			default  1 # C3 and others
			help
				GPIO number (IOxx) to UART TX.
				Some GPIOs are used for other purposes (flash connections, etc.).
				GPIOs 35-39 are input-only so cannot be used as outputs.

		config UART_RX_GPIO
			int "UART RX GPIO number"
			range 0 GPIO_RANGE_MAX
			default 16 if IDF_TARGET_ESP32
			default 34 if IDF_TARGET_ESP32S2 || IDF_TARGET_ESP32S3
			default  0 # C3 and others
			help
				GPIO number (IOxx) to UART RX.
				Some GPIOs are used for other purposes (flash connections, etc.).
				GPIOs 35-39 are input-only so cannot be used as outputs.

		config UART_BAUD_RATE
			int "UART communication speed"
			range 1200 115200
			default 115200
			help
				UART communication speed.

	endmenu

endmenu
```
